#include "oled.h"

#include "i2c.h"

#include <string.h>

#define OLED_I2C_ADDR        (0x3C << 1)
#define OLED_WIDTH           128U
#define OLED_HEIGHT          64U
#define OLED_PAGES           (OLED_HEIGHT / 8U)
#define OLED_CTRL_CMD        0x00U
#define OLED_CTRL_DATA       0x40U
#define OLED_FONT_W          6U

static uint8_t s_oled_buf[OLED_WIDTH * OLED_PAGES];
static uint8_t s_row = 0;
static uint8_t s_col = 0;

/* 6x8 font for ASCII 32..127 */
static const uint8_t kFont6x8[][6] = {
  {0x00,0x00,0x00,0x00,0x00,0x00},{0x00,0x00,0x5F,0x00,0x00,0x00},{0x00,0x07,0x00,0x07,0x00,0x00},{0x14,0x7F,0x14,0x7F,0x14,0x00},
  {0x24,0x2A,0x7F,0x2A,0x12,0x00},{0x23,0x13,0x08,0x64,0x62,0x00},{0x36,0x49,0x55,0x22,0x50,0x00},{0x00,0x05,0x03,0x00,0x00,0x00},
  {0x00,0x1C,0x22,0x41,0x00,0x00},{0x00,0x41,0x22,0x1C,0x00,0x00},{0x14,0x08,0x3E,0x08,0x14,0x00},{0x08,0x08,0x3E,0x08,0x08,0x00},
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  {0x00,0x00,0x7F,0x00,0x00,0x00},{0x00,0x41,0x36,0x08,0x00,0x00},{0x08,0x04,0x08,0x10,0x08,0x00},{0x00,0x06,0x09,0x09,0x06,0x00}
};

static void OLED_WriteCmd(uint8_t cmd)
{
  uint8_t pkt[2] = {OLED_CTRL_CMD, cmd};
  (void)HAL_I2C_Master_Transmit(&hi2c1, OLED_I2C_ADDR, pkt, sizeof(pkt), 100);
}

static void OLED_WriteData(const uint8_t *data, uint16_t len)
{
  uint8_t tx[17];
  uint16_t idx = 0;
  tx[0] = OLED_CTRL_DATA;
  while (idx < len)
  {
    uint16_t remaining = (uint16_t)(len - idx);
    uint16_t chunk = (remaining > 16U) ? 16U : remaining;
    memcpy(&tx[1], &data[idx], chunk);
    (void)HAL_I2C_Master_Transmit(&hi2c1, OLED_I2C_ADDR, tx, (uint16_t)(chunk + 1U), 100);
    idx += chunk;
  }
}

void OLED_Init(void)
{
  HAL_Delay(100);
  OLED_WriteCmd(0xAE);
  OLED_WriteCmd(0x20); OLED_WriteCmd(0x00);
  OLED_WriteCmd(0xB0);
  OLED_WriteCmd(0xC8);
  OLED_WriteCmd(0x00);
  OLED_WriteCmd(0x10);
  OLED_WriteCmd(0x40);
  OLED_WriteCmd(0x81); OLED_WriteCmd(0x7F);
  OLED_WriteCmd(0xA1);
  OLED_WriteCmd(0xA6);
  OLED_WriteCmd(0xA8); OLED_WriteCmd(0x3F);
  OLED_WriteCmd(0xA4);
  OLED_WriteCmd(0xD3); OLED_WriteCmd(0x00);
  OLED_WriteCmd(0xD5); OLED_WriteCmd(0x80);
  OLED_WriteCmd(0xD9); OLED_WriteCmd(0xF1);
  OLED_WriteCmd(0xDA); OLED_WriteCmd(0x12);
  OLED_WriteCmd(0xDB); OLED_WriteCmd(0x40);
  OLED_WriteCmd(0x8D); OLED_WriteCmd(0x14);
  OLED_WriteCmd(0xAF);
  OLED_Clear();
  OLED_Update();
}

void OLED_Clear(void)
{
  memset(s_oled_buf, 0, sizeof(s_oled_buf));
  s_row = 0;
  s_col = 0;
}

void OLED_SetCursor(uint8_t row, uint8_t col)
{
  if (row < OLED_PAGES) s_row = row;
  if (col < (OLED_WIDTH / OLED_FONT_W)) s_col = col;
}

void OLED_Print(const char *str)
{
  while (*str != '\0')
  {
    uint8_t ch = (uint8_t)*str++;
    uint16_t base;
    uint8_t i;
    if (ch < 32U || ch > 127U)
    {
      ch = '?';
    }
    if (s_col >= (OLED_WIDTH / OLED_FONT_W))
    {
      s_col = 0;
      s_row++;
      if (s_row >= OLED_PAGES)
      {
        break;
      }
    }
    base = (uint16_t)s_row * OLED_WIDTH + (uint16_t)s_col * OLED_FONT_W;
    for (i = 0; i < OLED_FONT_W; i++)
    {
      s_oled_buf[base + i] = kFont6x8[ch - 32U][i];
    }
    s_col++;
  }
}

void OLED_PrintAt(uint8_t row, uint8_t col, const char *str)
{
  OLED_SetCursor(row, col);
  OLED_Print(str);
}

void OLED_Update(void)
{
  uint8_t page;
  for (page = 0; page < OLED_PAGES; page++)
  {
    OLED_WriteCmd((uint8_t)(0xB0U + page));
    OLED_WriteCmd(0x00);
    OLED_WriteCmd(0x10);
    OLED_WriteData(&s_oled_buf[page * OLED_WIDTH], OLED_WIDTH);
  }
}
